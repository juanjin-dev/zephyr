## boards/rakwireless/rak11161/Kconfig.rak11161
```kconfig
# SPDX-License-Identifier: Apache-2.0
# Copyright (c) 2026 RAKwireless Technology Limited

config BOARD_RAK11161
	select SOC_STM32WLE5XX
```

## boards/rakwireless/rak11310/Kconfig
```kconfig
# SPDX-License-Identifier: Apache-2.0
# Copyright (c) 2026 RAKwireless Technology Limited

config BOARD_RAK11310
	select RP2_FLASH_W25Q080
	select BOARD_EARLY_INIT_HOOK if PWM || ADC
	select PINCTRL_DYNAMIC if PWM || ADC
	select PINCTRL_KEEP_SLEEP_STATE if PWM || ADC
```

## boards/rakwireless/rak11310/Kconfig.rak11310
```kconfig
# SPDX-License-Identifier: Apache-2.0
# Copyright (c) 2026 RAKwireless Technology Limited

config BOARD_RAK11310
	select SOC_RP2040
```

## boards/rakwireless/rak11721/Kconfig.defconfig
```kconfig
# SPDX-License-Identifier: Apache-2.0
# Copyright (c) 2026 RAKwireless Technology Limited

if BOARD_RAK11721

config SYS_CLOCK_HW_CYCLES_PER_SEC
	default 32768 if AMBIQ_STIMER_TIMER

endif # BOARD_RAK11721
```

## boards/rakwireless/rak11721/Kconfig.rak11721
```kconfig
# SPDX-License-Identifier: Apache-2.0
# Copyright (c) 2026 RAKwireless Technology Limited

config BOARD_RAK11721
	select SOC_APOLLO3_BLUE
```

## boards/rakwireless/rak11721/rak11721_defconfig
```kconfig
# SPDX-License-Identifier: Apache-2.0
# Copyright (c) 2026 RAKwireless Technology Limited

CONFIG_CONSOLE=y
CONFIG_UART_CONSOLE=y
CONFIG_SERIAL=y
CONFIG_UART_INTERRUPT_DRIVEN=y
```

## boards/rakwireless/rak19026/Kconfig.rak19026
```kconfig
# SPDX-License-Identifier: Apache-2.0
# Copyright (c) 2026 RAKwireless Technology Limited

config BOARD_RAK19026
	select SOC_NRF52840_QIAA
```

## boards/rakwireless/rak19026/board.yml
```yaml
board:
  name: rak19026
  full_name: RAK19026 WisMesh Base
  vendor: rakwireless
  socs:
  - name: nrf52840
```

## boards/shields/rakwireless_rak14000/Kconfig.defconfig
```kconfig
# SPDX-License-Identifier: Apache-2.0
# Copyright (c) 2026 RAKwireless Technology Limited

if SHIELD_RAKWIRELESS_RAK14000

if DISPLAY

if LVGL

config LV_Z_VDB_SIZE
	default 64

config LV_Z_COLOR_MONO_HW_INVERSION
	default y

choice LV_COLOR_DEPTH
	default LV_COLOR_DEPTH_1
endchoice

endif # LVGL

endif # DISPLAY

endif # SHIELD_RAKWIRELESS_RAK14000
```

## boards/shields/rakwireless_rak14000/Kconfig.shield
```kconfig
# SPDX-License-Identifier: Apache-2.0
# Copyright (c) 2026 RAKwireless Technology Limited

config SHIELD_RAKWIRELESS_RAK14000_WB
	def_bool $(shields_list_contains,rakwireless_rak14000_wb)

config SHIELD_RAKWIRELESS_RAK14000_WBR
	def_bool $(shields_list_contains,rakwireless_rak14000_wbr)

config SHIELD_RAKWIRELESS_RAK14000
	def_bool SHIELD_RAKWIRELESS_RAK14000_WB || \
		SHIELD_RAKWIRELESS_RAK14000_WBR
```

## boards/shields/rakwireless_rak14014/Kconfig.defconfig
```kconfig
# SPDX-License-Identifier: Apache-2.0
# Copyright (c) 2026 RAKwireless Technology Limited

if SHIELD_RAKWIRELESS_RAK14014

config REGULATOR
	default y if DISPLAY

if GPIO_PCA95XX

config GPIO_PCA95XX_INTERRUPT
	default y

endif # GPIO_PCA95XX

if DISPLAY

if LVGL

config LV_Z_VDB_SIZE
	default 16

config LV_Z_DPI_DEF
	default 166

config INPUT
	default y

endif # LVGL

endif # DISPLAY

endif # SHIELD_RAKWIRELESS_RAK14014
```

## drivers/ethernet/wiznet/Kconfig
```kconfig
# WIZnet Ethernet driver configuration options
#
# Copyright (c) 2020 Linumiz
# Copyright (c) 2025 WIZnet Co., Ltd.
# Copyright (c) 2026 RAKwireless Technology Limited
# SPDX-License-Identifier: Apache-2.0

config ETH_WIZNET
	bool
	help
	  Shared MACRAW core for the WIZnet stand-alone Ethernet controllers.

menuconfig ETH_W5500
	bool "W5500 Ethernet Controller"
	default y
	depends on DT_HAS_WIZNET_W5500_ENABLED
	select ETH_WIZNET
	select SPI
	help
	  W5500 Stand-Alone Ethernet Controller
	  with SPI Interface

config ETH_W5500_RX_THREAD_STACK_SIZE
	int "Stack size for internal incoming packet handler"
	depends on ETH_W5500
	default 1024
	help
	  Size of the stack used for internal thread which is ran for
	  incoming packet processing.

config ETH_W5500_RX_THREAD_PRIO
	int "Priority for internal incoming packet handler"
	depends on ETH_W5500
	default 2
	help
	  Priority level for internal thread which is ran for incoming
	  packet processing.

config ETH_W5500_TIMEOUT
	int "IP buffer timeout"
	depends on ETH_W5500
	default 100
	help
	  Given timeout in milliseconds. Maximum amount of time
	  that the driver will wait from the IP stack to get
	  a memory buffer before the Ethernet frame is dropped.

config ETH_W5500_MONITOR_PERIOD
	int "Monitor task execution period"
	depends on ETH_W5500
	default 500
	help
	  Monitor task execution period in milliseconds. The monitor task is
	  periodically executed to detect and report any changes in the
	  link status to the operating system.

config ETH_W5500_POLL_PERIOD
	int "W5500 polling period in milliseconds"
	depends on ETH_W5500
	default 10
	help
	  Polling interval in milliseconds for RX data and link status
	  when operating in polling mode (no int-gpios defined in
	  devicetree).

menuconfig ETH_W6100
	bool "W6100 Ethernet Controller"
	default y
	depends on DT_HAS_WIZNET_W6100_ENABLED
	select ETH_WIZNET
	select SPI
	help
	  W6100 Stand-Alone Ethernet Controller
	  with SPI Interface

config ETH_W6100_RX_THREAD_STACK_SIZE
	int "Stack size for internal incoming packet handler"
	depends on ETH_W6100
	default 800
	help
	  Size of the stack used for internal thread which is ran for
	  incoming packet processing.

config ETH_W6100_RX_THREAD_PRIO
	int "Priority for internal incoming packet handler"
	depends on ETH_W6100
	default 2
	help
	  Priority level for internal thread which is ran for incoming
	  packet processing.

config ETH_W6100_TIMEOUT
	int "IP buffer timeout"
	depends on ETH_W6100
	default 100
	help
	  Given timeout in milliseconds. Maximum amount of time
	  that the driver will wait from the IP stack to get
	  a memory buffer before the Ethernet frame is dropped.

config ETH_W6100_POLL_PERIOD
	int "W6100 polling period in milliseconds"
	depends on ETH_W6100
	default 10
	help
	  Polling interval in milliseconds for RX data and link status
	  when operating in polling mode (no int-gpios defined in
	  devicetree).

config ETH_W6100_MONITOR_PERIOD
	int "Monitor task execution period"
	depends on ETH_W6100
	default 500
	help
	  Monitor task execution period in milliseconds. The monitor task is
	  periodically executed to detect and report any changes in the
	  link status to the operating system.

menuconfig ETH_W6300
	bool "W6300 Ethernet Controller"
	default y
	depends on DT_HAS_WIZNET_W6300_ENABLED
	select SPI
	select GPIO
	help
	  W6300 Stand-Alone Ethernet Controller with SPI interface.

if ETH_W6300

config ETH_W6300_RX_THREAD_STACK_SIZE
	int "Stack size for internal incoming packet handler"
	default 1024
	help
	  Size of the stack used for internal thread which is ran for
	  incoming packet processing.

config ETH_W6300_RX_THREAD_PRIO
	int "Priority for internal incoming packet handler"
	default 2
	help
	  Priority level for internal thread which is ran for incoming
	  packet processing.

config ETH_W6300_TIMEOUT
	int "IP buffer timeout"
	default 100
	help
	  Given timeout in milliseconds. Maximum amount of time
	  that the driver will wait from the IP stack to get
	  a memory buffer before the Ethernet frame is dropped.

config ETH_W6300_MONITOR_PERIOD
	int "Monitor task execution period"
	default 500
	help
	  Monitor task execution period in milliseconds. The monitor task is
	  periodically executed to detect and report any changes in the
	  link status to the operating system.

endif # ETH_W6300
```

## drivers/input/Kconfig.rak14004
```kconfig
# Copyright (c) 2026 RAKwireless Technology Limited
# SPDX-License-Identifier: Apache-2.0

config INPUT_RAK14004
	bool "RAK14004 WisBlock keypad module"
	default y
	depends on DT_HAS_RAKWIRELESS_RAK14004_ENABLED
	select GPIO
	select I2C
	help
	  Enable the driver for the RAK14004 WisBlock keypad module, which scans
	  a passive key matrix and reports the pressed keys over I2C.
```

## dts/bindings/input/rakwireless,rak14004.yaml
```yaml
# Copyright (c) 2026 RAKwireless Technology Limited
# SPDX-License-Identifier: Apache-2.0

title: RAKwireless RAK14004 WisBlock Keypad Module

description: |
  Scans a passive key matrix and reports the pressed keys over I2C. The matrix
  is a separate module plugged into the keypad connector, so its size is a
  property of the pair rather than of the RAK14004 alone: a RAK14009 is 3 by 3,
  a RAK14010 is 3 by 4 and a RAK14011 is 4 by 4.

  The driver reports row and column events, which an input-keymap child turns
  into key codes.

  The module runs its own firmware and answers on the bus about 1.7 seconds
  after it is powered, so a host that switches its supply sees nothing on the
  bus for that long. Nothing is lost by it: the module drives the interrupt
  line once it is up, and the driver reads the matrix only then.

compatible: "rakwireless,rak14004"

include: [i2c-device.yaml]

properties:
  int-gpios:
    type: phandle-array
    required: true
    description: |
      Line the module asserts when the set of pressed keys changes. The module
      holds it low and lets it rise, so it needs a pull-up to reach a valid
      high: without one the assertion is never seen.

  reset-gpios:
    type: phandle-array
    description: |
      Reset line, held inactive while the driver is loaded. The module is not
      reset on purpose: it is already running by the time anything reads it,
      and resetting it would cost another power-up wait.

  row-size:
    type: int
    required: true
    min: 1
    max: 8
    description: Number of rows the attached key matrix has.

  col-size:
    type: int
    required: true
    min: 1
    max: 8
    description: Number of columns the attached key matrix has.

examples:
  - |
    #include <zephyr/dt-bindings/gpio/gpio.h>
    #include <zephyr/dt-bindings/input/input-event-codes.h>
    #include <zephyr/dt-bindings/input/keymap.h>

    &i2c0 {
        keypad: keypad@5f {
            compatible = "rakwireless,rak14004";
            reg = <0x5f>;
            int-gpios = <&gpio0 1 (GPIO_PULL_UP | GPIO_ACTIVE_HIGH)>;
            row-size = <3>;
            col-size = <3>;

            keymap {
                compatible = "input-keymap";
                keymap = <
                    MATRIX_KEY(0, 0, INPUT_KEY_1)
                    MATRIX_KEY(0, 1, INPUT_KEY_2)
                    MATRIX_KEY(0, 2, INPUT_KEY_3)
                    MATRIX_KEY(1, 0, INPUT_KEY_4)
                    MATRIX_KEY(1, 1, INPUT_KEY_5)
                    MATRIX_KEY(1, 2, INPUT_KEY_6)
                    MATRIX_KEY(2, 0, INPUT_KEY_7)
                    MATRIX_KEY(2, 1, INPUT_KEY_8)
                    MATRIX_KEY(2, 2, INPUT_KEY_9)
                >;
                row-size = <3>;
                col-size = <3>;
            };
        };
    };
```

## dts/bindings/nfc/nfc-controller.yaml
```yaml
# Copyright (c) 2026 RAKwireless Technology Limited
# SPDX-License-Identifier: Apache-2.0

description: Common fields for NFC controllers

include: [base.yaml]
```

## dts/bindings/nfc/nxp,mfrc522-spi.yaml
```yaml
# Copyright (c) 2026 RAKwireless Technology Limited
# SPDX-License-Identifier: Apache-2.0

description: NXP MFRC522 ISO/IEC 14443A reader on SPI

compatible: "nxp,mfrc522"

include: [nfc-controller.yaml, spi-device.yaml]

on-bus: spi

properties:
  reset-gpios:
    type: phandle-array
    description: NRSTPD reset / power-down line (active low).

  irq-gpios:
    type: phandle-array
    description: |
      IRQ line the reader asserts on transceive completion. Optional; the
      driver falls back to polling the interrupt status register.
```

## subsys/lorawan/native/region/Kconfig
```kconfig
# Native LoRaWAN region configuration
#
# Copyright (c) 2026 Carlo Caione <ccaione@baylibre.com>
# SPDX-License-Identifier: Apache-2.0

if LORA_MODULE_BACKEND_NATIVE

config LORAWAN_NATIVE_DUTY_CYCLE
	bool "Enforce regional duty cycle limits"
	help
	  Enable per-sub-band duty cycle enforcement as required by
	  ETSI regulations (e.g. EU868). When enabled, the stack
	  tracks on-air time per sub-band and blocks channels whose
	  off-time has not yet elapsed.

	  Disable this option for testing or when duty cycle
	  enforcement is handled externally.

config LORAWAN_NATIVE_LBT_MAX_ATTEMPTS
	int "Maximum listen-before-talk attempts"
	default 8
	help
	  How many channels to try before giving up on finding a clear one,
	  in regions that listen before they talk rather than hold to a duty
	  cycle. Channel selection is random, so each attempt is a fresh
	  draw. Regions without LBT never spend more than one attempt.

config LORAWAN_NATIVE_MAX_CHANNELS
	int
	default 16
	help
	  Sizes the per-session channel table.  Not user-tunable: the value
	  is dictated by the selected region(s).  Currently only EU868 is
	  implemented (16-channel plan).  Regions with larger channel plans
	  will extend this config with 'default N if LORAWAN_REGION_X' lines
	  when they land.

endif # LORA_MODULE_BACKEND_NATIVE
```
